/dts-v1/;
/plugin/;

#include <dt-bindings/clock/starfive-jh7100.h>

/ {
	compatible = "starfive,jh7100";
};

&{/soc} {
	gpu2d: gpu@10100000 {
		compatible = "vivante,gc";
		reg = <0x0 0x10100000 0x0 0x40000>;
		interrupts = <20>;
		clocks =
			<&clkgen JH7100_CLK_GC300_2X>,
			<&clkgen JH7100_CLK_GC300_AHB>,
			<&clkgen JH7100_CLK_GC300_AXI>;
		clock-names = "core", "reg", "bus";
	};
};
