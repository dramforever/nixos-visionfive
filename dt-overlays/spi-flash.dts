/dts-v1/;
/plugin/;

#include <dt-bindings/clock/starfive-jh7100.h>

/ {
	compatible = "starfive,visionfive-v1";
};

&qspi {
	clocks = <&clkgen JH7100_CLK_QSPI_REF>,
		<&clkgen JH7100_CLK_QSPI_AHB>,
		<&clkgen JH7100_CLK_QSPI_APB>;
	clock-names = "refclk", "ahb_clk", "apb_clk";
	status = "okay";
};

&nor_flash {
	compatible = "jedec,spi-nor";
};
